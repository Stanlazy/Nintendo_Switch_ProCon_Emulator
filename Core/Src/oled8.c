#include "oled8.h"

static const uint8_t init_cmd[] = {
	0x00,
	0xae,					//Display off 
	0x81, 0xff,				//Contrast 0x01-0xff
	0xa4,					//Full on override
	0xa6,					//Inverse display off //0xa7
	0x2e,					//Deactivate scroll
	0x20, 0x00,				//Address mode vertical
	0x22, 0, 3,				//Set Page Address
	0x21, 0, 127,			//Set Column Address
	0x40,					//Display start line
	0xa1,					//Set Segment Re-Map //0xa0
	0xa8, 0x1f,				//Set Multiplex Ratio
	0xc0,					//Set COM Output Scan Direction //0xc8
	0xd3, 0x00,				//Set Display Offset
	0xda, 0x12,				//Set COM Pins Hardware Configuration
	0xd5, 0xf0,				//Set Display Clock Divide Ratio/Oscillator Frequency
	0xd9, 0x11,				//Set Pre-Charge Period
	0xdb, 0x00,				//Set VCOMH Deselect Level 
	0x8d, 0x15, 			//Set Charge Pump
	0xaf};					//Display on 

static const uint8_t font_6_8[95*5] = {
	0x00, 0x00, 0x00, 0x00, 0x00,
	0x00, 0x00, 0x5f, 0x00, 0x00,
	0x00, 0x07, 0x00, 0x07, 0x00,
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	0x04, 0x02, 0x02, 0x02, 0x01};

static uint8_t vram[OLED_X_SIZE * OLED_Y_SIZE / 8 + 1];

void oled8_update(){
	HAL_I2C_Master_Transmit_IT(&OLED_I2C_HANDLE, OLED_I2C_ADDR, (uint8_t*)vram, sizeof(vram));
}

void oled8_init(){
	HAL_I2C_Master_Transmit(&OLED_I2C_HANDLE, OLED_I2C_ADDR, (uint8_t*)init_cmd, sizeof(init_cmd), OLED_TIMEOUT);
	vram[0] = 0x40;
	HAL_I2C_Master_Transmit(&OLED_I2C_HANDLE, OLED_I2C_ADDR, (uint8_t*)vram, sizeof(vram), OLED_TIMEOUT);
}

void oled8_putc(uint8_t x, uint8_t y, char c){
	uint8_t* ptr = &(vram[1 + (y * 128) + (x * 6)]);
	uint8_t* fnt = (uint8_t*)(&(font_6_8[(c - 0x20) * 5]));
	for(char i = 0; i < 5; i++){
		*ptr = *fnt;
		ptr++;
		fnt++;
	}
	*ptr = 0x00;
}

void oled8_puts(uint8_t x, uint8_t y, char* s){
	while(*s){
		oled8_putc(x, y, *s);
		x++;
		s++;
	}
}

void oled8_putn(uint8_t x, uint8_t y, int num, uint8_t len){
	x = x + len;
	char flag = 0;
	if(num < 0){
		flag = 1;
		num = 0 - num;
	}
	for(uint8_t i = 0; i < len; i++){
		oled8_putc(x, y, 0x30 + (num % 10));
		num /= 10;
		x--;
	}
	if(flag) oled8_putc(x, y, '-');
	else oled8_putc(x, y, ' ');
}

void oled8_putf(uint8_t x, uint8_t y, float num, uint8_t lenl, uint8_t lenr){
	x = x + lenl + lenr + 1;
	int sth = 1;
	for(uint8_t i = 0; i < lenr; i++){
		sth *= 10;
	}
	num *= sth;
	sth = (int)num;
	char flag = 0;
	if(sth < 0){
		flag = 1;
		sth = 0 - sth;
	}
	for(uint8_t i = 0; i < lenr; i++){
		oled8_putc(x, y, 0x30 + (sth % 10));
		sth /= 10;
		x--;
	}
	oled8_putc(x, y, '.');
	x--;
	for(uint8_t i = 0; i < lenl; i++){
		oled8_putc(x, y, 0x30 + (sth % 10));
		sth /= 10;
		x--;
	}
	if(flag) oled8_putc(x, y, '-');
	else oled8_putc(x, y, ' ');
}
